## sources/image/conf/bblayers.conf
```bitbake
POKY_BBLAYERS_CONF_VERSION = "2"

BBPATH = "${TOPDIR}"
BBFILES ?= ""
BBLAYERS ?= " \
  ${TOPDIR}/../../externals/poky/meta \
  ${TOPDIR}/../../externals/poky/meta-poky \
  ${TOPDIR}/../../externals/poky/meta-yocto-bsp \
  ${TOPDIR}/../../externals/meta-openembedded/meta-oe \
  ${TOPDIR}/../../externals/meta-openembedded/meta-python \
  ${TOPDIR}/../../externals/meta-openembedded/meta-networking \
  ${TOPDIR}/../../externals/meta-openembedded/meta-multimedia \
  ${TOPDIR}/../../externals/meta-raspberrypi \
  ${TOPDIR}/../../sources/image/meta-1602a \
  "
```

## sources/image/meta-1602a/conf/layer.conf
```bitbake
# We have a conf and classes directory, add to BBPATH
BBPATH .= ":${LAYERDIR}"

# We have recipes-* directories, add to BBFILES
BBFILES += "${LAYERDIR}/recipes-*/*/*.bb \
            ${LAYERDIR}/recipes-*/*/*.bbappend"

BBFILE_COLLECTIONS += "meta-1602a"
BBFILE_PATTERN_meta-1602a = "^${LAYERDIR}/"
BBFILE_PRIORITY_meta-1602a = "6"

LAYERDEPENDS_meta-1602a = "core"
LAYERSERIES_COMPAT_meta-1602a = "dunfell"
```
